BO_ 123 EngineSpeed: 48 Engine
	SG_ EngineSpeed : 0|32@1+ (0.1,0) [0|8000] "RPM" DriverGateway
	SG_ BatteryTemperature : 32|12@1+(8,4) (1,0) [0|8000] "ºC" DriverGateway

TP_ EngineSpeed Engine/Metrics/Speed
