BO_ 123 Message1: 6 Engine
	SG_ EngineSpeed : 0|32@1+ (0.1,0) [0|8000] "RPM" DriverGateway
	SG_ BatteryTemperature : 32|12@1+ (1,400) [0|8000] "ºC" DriverGateway

BO_ 456 Empty: 0 Engine

BA_DEF_ SG_ "VeraMqttTopic" STRING ;
BA_ "VeraMqttTopic" SG_ 123 EngineSpeed "Engine/Metrics/Speed";
