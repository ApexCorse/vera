BO_ 123 Message1: 6 Engine
	SG_ EngineSpeed : 0|32@1+ (0.1,0) [0|8000] "RPM" DriverGateway
	SG_ BatteryTemperature : 32|12@1+ (1,400) [0|8000] "ºC" DriverGateway

CM_ SG_ 123 EngineSpeed "vera:mqtt-topic=Engine/Metrics/Speed";
