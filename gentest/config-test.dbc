BO_ 123 EngineSpeed: 24 Engine
	SG_ EngineSpeed : 0|1@1+ (0.1,0) [0|8000] "RPM" DriverGateway
	SG_ OilTemperature : 1|1@1- (1,-40) [-40|150] "ºC" DriverGateway,EngineGateway
